## config/boards/shields/Kconfig.shield
```kconfig
config SHIELD_JEFF01_LEFT
    def_bool $(shields_list_contains, jeff01_left)

config SHIELD_JEFF01_RIGHT
    def_bool $(shields_list_contains, jeff01_right)
```

## config/boards/shields/jeff01/Kconfig.deconfig
```kconfig
if SHIELD_JEFF01_LEFT

config ZMK_KEYBOARD_NAME
    default "Jeff01"

config ZMK_SPLIT_ROLE_CENTRAL
    default y

endif

if SHIELD_JEFF01_LEFT || SHIELD_JEFF01_RIGHT

config ZMK_SPLIT
    default y

endif
```
